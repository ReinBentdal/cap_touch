## boards/arm/nrf52_basic/Kconfig.board
```kconfig
config BOARD_NRF52_BASIC
	bool "nRF52 DK NRF52832"
	depends on SOC_NRF52832_QFAA
```

## boards/arm/nrf52_basic/nrf52_basic_defconfig
```kconfig
CONFIG_SOC_SERIES_NRF52X=y
CONFIG_SOC_NRF52832_QFAA=y
CONFIG_BOARD_NRF52_BASIC=y

# internal LF clock, much lower power consumption because HFCLK does not need to run
CONFIG_CLOCK_CONTROL_NRF_K32SRC_RC=y 

# Enable MPU
CONFIG_ARM_MPU=y

CONFIG_PINCTRL=y

# Enable hardware stack protection
CONFIG_HW_STACK_PROTECTION=y

# enable GPIO
CONFIG_GPIO=y

CONFIG_GPIO_AS_PINRESET=n
```

## boards/arm/nrf52_monkey/Kconfig.board
```kconfig
config BOARD_NRF52_MONKEY
	bool "nRF52 DK NRF52832"
	depends on SOC_NRF52832_QFAA
```

## src/bluetooth/Kconfig
```kconfig
menu "bluetooth"

config LOG_BLUETOOTH_LEVEL
    int "Log level for button.h"
    default 3

endmenu
```
